## firmware/esp32cam/sdkconfig.defaults
```kconfig
# ESP32-CAM Configuration Defaults

# Camera Configuration
CONFIG_SCCB_CLK_FREQ=100000
CONFIG_OV2640_SUPPORT=y
CONFIG_OV7725_SUPPORT=n
CONFIG_OV3660_SUPPORT=n
CONFIG_OV5640_SUPPORT=n

# PSRAM Configuration (required for camera)
CONFIG_ESP32_SPIRAM_SUPPORT=y
CONFIG_SPIRAM_USE_MALLOC=y
CONFIG_SPIRAM_SPEED_80M=y
CONFIG_SPIRAM=y
CONFIG_SPIRAM_BOOT_INIT=y
CONFIG_SPIRAM_IGNORE_NOTFOUND=n
CONFIG_SPIRAM_USE=y
CONFIG_SPIRAM_MEMTEST=y

# Flash Configuration
CONFIG_ESPTOOLPY_FLASHSIZE_4MB=y
CONFIG_ESPTOOLPY_FLASHSIZE="4MB"

# FreeRTOS Configuration
CONFIG_FREERTOS_HZ=1000

# Log Level
CONFIG_LOG_DEFAULT_LEVEL_INFO=y
```
